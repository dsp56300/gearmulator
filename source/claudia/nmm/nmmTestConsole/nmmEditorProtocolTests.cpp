#include "nmmLib/nmmhardware.h"
#include <algorithm>
#include <cmath>
#include <iostream>
#include <stdexcept>

namespace
{
    void require(bool value,const char* text) {if(!value) throw std::runtime_error(text);}
    using Bytes=std::vector<uint8_t>;
    Bytes message(uint8_t command,Bytes payload)
    {
        Bytes result{0xf0,0x33,command,6};result.insert(result.end(),payload.begin(),payload.end());
        if(command) {unsigned sum=0;for(auto b:result) sum+=b;result.push_back(sum&127);}
        result.push_back(0xf7);return result;
    }
    std::vector<Bytes> queryNative(nmm::Hardware& hw,const Bytes& request)
    {
        hw.receiveEditorMidi();require(hw.sendEditorMidi(request.data(),request.size()),"PC input capacity");
        std::vector<Bytes> replies;Bytes current;
        for(unsigned i=0;i<188;++i)
        {
            hw.render(256,1000000);
            for(auto b:hw.receiveEditorMidi())
            {
                if(b>=0xf8) continue;
                if(b==0xf0) current.clear();current.push_back(b);
                if(b==0xf7) {replies.push_back(current);current.clear();}
            }
        }
        return replies;
    }
    bool has(const std::vector<Bytes>& replies,uint8_t command)
    {
        for(const auto& r:replies) if(r.size()>6 && r[0]==0xf0 && r[1]==0x33 && r[2]==command && r[3]==6 && r.back()==0xf7) return true;
        return false;
    }
    double sound(nmm::Hardware& hw)
    {
        for(auto note:{60,64,67,71}) hw.sendMidi(0x90,note,100);
        hw.render(9600,10000000);auto audio=hw.render(9600,10000000);
        double sum=0,squares=0;
        for(auto f:audio) {require(std::isfinite(f[0]),"Finite edited patch audio");sum+=f[0];squares+=double(f[0])*f[0];}
        hw.sendMidi(0xb0,123,0);hw.render(9600,10000000);
        return std::sqrt(std::max(0.0,squares/audio.size()-std::pow(sum/audio.size(),2)));
    }
}
int main(int argc,char** argv)
{
    try
    {
        require(argc==3 || (argc==4 && std::string(argv[3])=="--audio-driven"),"usage: nmmEditorProtocolTests firmware FourVoices.pch [--audio-driven]");
        nmm::Hardware hw(argv[1]);hw.boot(30000000);hw.loadPatch(argv[2],30000000);
        // Frames generated by the public G1 editor's IAm/GetSynthSettings/GetPatch encoders.
        const auto hello=queryNative(hw,message(0,{0,3,3}));bool micro=false;
        for(const auto& r:hello) if(r.size()==12 && r[2]==0 && r[4]==1 && r[5]==3 && r[6]==3 && r[10]==2) micro=true;
        require(micro,"Native OS 3.03 Micro discovery");
        require(has(queryNative(hw,message(0x5c,{68,2,6,8,4})),0x78),"Synth settings dump");
        require(has(queryNative(hw,message(0x5c,{65,53})),0x58),"Patch ID acknowledgement");
        for(const auto& payload:std::vector<Bytes>{{0,32,40},{0,75,1},{0,75,0},{0,83,1},{0,83,0},{0,76,1},{0,76,0},{0,78,1},{0,78,0},{0,99},{0,102},{0,97}})
            require(has(queryNative(hw,message(0x5c,payload)),0x78),"Native editor patch section dump");
        const auto before=sound(hw);require(before>.01,"Four-voice sound before editing");
        queryNative(hw,message(0x4c,{0,64,1,4,0,80}));
        require(hw.editorKnobs()[0].value==80,"Native parameter edit updates assigned knob");
        const auto after=sound(hw);require(after>.001 && after<before*.8,"Native parameter edit changes audio without host gain");
        const auto packets=hw.exportEditorPatch(56);require(packets.size()>1,"Multi-packet snapshot fixture");
        Bytes snapshot;for(const auto& packet:packets) snapshot.insert(snapshot.end(),packet.begin(),packet.end());
        nmm::Hardware restored(argv[1]);
        if(argc==4) {restored.setAudioDrivenExecution(64,false);restored.setDeadlineLinkedJit(true);}
        restored.boot(30000000);restored.initializePatch(30000000);
        restored.restoreEditorPatch(snapshot);
        require(restored.editorKnobs()[0].value==80,"Native multi-packet restore retains edited value");
        require(restored.editorPatchName()==hw.editorPatchName(),"Native restore retains patch name");
        const auto recovered=sound(restored);require(std::abs(recovered-after)<after*.15,"Four-voice audio after native upload and compile");
        // Exercise the live-control boundary throughout a multipart upload,
        // including the final packet's native DSP recompilation. A busy editor
        // must defer controls without throwing or consuming incoming bytes.
        unsigned deferred=0,applied=0;
        for(const auto& packet:packets)
        {
            restored.receiveEditorMidi();
            require(restored.sendEditorMidi(packet.data(),packet.size()),"Live upload input capacity");
            const auto beforeAttempt=restored.timing().cycles;
            require(!restored.prepareControlUpdate(),"Queued editor packet defers live control");
            require(restored.timing().cycles==beforeAttempt,"Queued editor input is not advanced by control preparation");
            bool acknowledged=false;Bytes reply;
            for(unsigned i=0;i<750 && !acknowledged;++i)
            {
                if(restored.prepareControlUpdate())
                {restored.setMasterVolume(100);++applied;}
                else ++deferred;
                restored.render(128,1000000);
                for(auto b:restored.receiveEditorMidi())
                {
                    if(b==0xf0) reply.clear();
                    reply.push_back(b);
                    if(b==0xf7 && reply.size()>=8 && reply[2]==0x58 && (reply[5]==0x36 || reply[5]==0x7f)) acknowledged=true;
                }
            }
            require(acknowledged,"Upload ACK survives pending live controls");
        }
        bool settled=false;
        for(unsigned i=0;i<750 && !settled;++i)
        {
            if(restored.prepareControlUpdate())
            {
                const auto knob=restored.editorKnobs()[0];
                require(knob.module!=0,"Uploaded patch retains mapped knob");
                restored.setPatchParameter(knob.area,knob.module,knob.parameter,73);
                ++applied;settled=true;
            }
            else {++deferred;restored.render(128,1000000);}
            restored.receiveEditorMidi();
        }
        require(settled && deferred && applied,"Live controls defer and resume after compilation");
        require(restored.editorKnobs()[0].value==73,"Deferred mapped control applies after upload");
        require(sound(restored)>.001,"Audio survives upload with pending controls");
        std::cout << "PASS editor: native discovery, all browser patch sections, live parameter/audio, multipart upload, saved patch restore, deferred controls (" << deferred << " deferrals); RMS " << before << " -> " << after << " -> " << recovered << '\n';
    }
    catch(const std::exception& e) {std::cerr << e.what() << '\n';return 1;}
}
