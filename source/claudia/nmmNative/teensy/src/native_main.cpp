#include <Arduino.h>

#include "graph101_oracle.h"
#include "graph101_board_runner.h"
#include "nord101_mcu_contract.h"
#include "nord101_reference_full_state.generated.h"
#include "nmm101_graph.h"

// Generated by nmmGraphDifferential --emit-board.  It intentionally lives in
// build/fixtures because the full state and expected hashes are local,
// provenance-pinned reference artifacts.
#include "graph101_vectors.h"

#include <cstddef>
#include <cstdint>

namespace
{
using nmm::native::Graph101;
using nmm::native::StereoWords;
using nmm::native::Word24;
using nmm::native::mcu::VoiceTransport;

constexpr uint32_t kSampleRate = 96000;
constexpr uint32_t kNominalCpuHz = F_CPU;
#if defined(ARDUINO_TEENSY41)
constexpr const char* kTarget = "teensy41";
#else
constexpr const char* kTarget = "teensy36";
#endif
constexpr uint32_t kCycleBudget = kNominalCpuHz / kSampleRate;
constexpr uint8_t kMidiRingSize = 32;

struct MidiEvent
{
    uint8_t type = 0;
    uint8_t note = 0;
    uint8_t velocity = 0;
};

volatile MidiEvent midiRing[kMidiRingSize]{};
volatile uint8_t midiHead = 0;
volatile uint8_t midiTail = 0;
volatile uint32_t midiAccepted = 0;
volatile uint32_t midiDropped = 0;
volatile uint32_t midiApplied = 0;

Graph101 realtimeGraph;
VoiceTransport realtimeVoice;
IntervalTimer sampleTimer;
volatile uint32_t renderedFrames = 0;
volatile uint32_t realtimeFrames = 0;
volatile uint32_t steppedFrames = 0;
volatile uint32_t realtimeControlMax = 0;
volatile uint32_t realtimeSampleMax = 0;
volatile uint32_t realtimeFrameMax = 0;
volatile uint32_t realtimeOverruns = 0;
volatile uint64_t realtimeAudioHash = nmm::native::graph101_oracle::initialHash;
volatile bool realtimeEnabled = false;

uint32_t cycleCounterOverhead = 0;
uint32_t previousReport = 0;

using OfflineResult = nmm::native::teensy::Graph101BoardResult;
OfflineResult offlineResult{};

bool popMidi(MidiEvent& event)
{
    const uint8_t tail = midiTail;
    if(tail == midiHead) return false;
    event.type = midiRing[tail].type;
    event.note = midiRing[tail].note;
    event.velocity = midiRing[tail].velocity;
    midiTail = static_cast<uint8_t>((tail + 1u) & (kMidiRingSize - 1u));
    return true;
}

void enqueueMidi(uint8_t type, uint8_t note, uint8_t velocity)
{
    noInterrupts();
    const uint8_t head = midiHead;
    const uint8_t next = static_cast<uint8_t>((head + 1u) & (kMidiRingSize - 1u));
    if(next == midiTail)
        ++midiDropped;
    else
    {
        midiRing[head].type = type;
        midiRing[head].note = note;
        midiRing[head].velocity = velocity;
        midiHead = next;
        ++midiAccepted;
    }
    interrupts();
}

void applyMidi(const MidiEvent& event)
{
    if(event.type == usbMIDI.NoteOn && event.velocity != 0)
        realtimeVoice.noteOn(event.note, event.velocity);
    else if(event.type == usbMIDI.NoteOff ||
            (event.type == usbMIDI.NoteOn && event.velocity == 0))
    {
        if(realtimeVoice.held && realtimeVoice.note == event.note)
            realtimeVoice.noteOff();
    }
    else
        return;

    realtimeGraph.setVoiceWords(realtimeVoice.pitch,
                                realtimeVoice.velocityWord,
                                realtimeVoice.gate);
    ++midiApplied;
}

void sampleTickCore(bool fromTimer)
{
    const uint32_t frame = renderedFrames;
    const uint32_t frameBegin = ARM_DWT_CYCCNT;
    MidiEvent event;
    unsigned applied = 0;
    while(applied < 8 && popMidi(event))
    {
        applyMidi(event);
        ++applied;
    }

    uint32_t controlCycles = 0;
    if((frame & 3u) == 0)
    {
        const uint32_t begin = ARM_DWT_CYCCNT;
        realtimeGraph.control();
        controlCycles = ARM_DWT_CYCCNT - begin;
        if(controlCycles > realtimeControlMax) realtimeControlMax = controlCycles;
    }

    const uint32_t sampleBegin = ARM_DWT_CYCCNT;
    const StereoWords output = realtimeGraph.sample();
    const uint32_t sampleCycles = ARM_DWT_CYCCNT - sampleBegin;
    if(sampleCycles > realtimeSampleMax) realtimeSampleMax = sampleCycles;
    realtimeAudioHash = nmm::native::graph101_oracle::hashAudio(
        realtimeAudioHash, output);
    const uint32_t frameCycles = ARM_DWT_CYCCNT - frameBegin;
    if(frameCycles > realtimeFrameMax) realtimeFrameMax = frameCycles;
    if(frameCycles > kCycleBudget) ++realtimeOverruns;
    ++renderedFrames;
    if(fromTimer) ++realtimeFrames;
    else ++steppedFrames;
    (void)controlCycles;
}

void sampleTick()
{
    sampleTickCore(true);
}

OfflineResult runOfflineGraphTest()
{
    sampleTimer.end();
    auto result = nmm::native::teensy::runGraph101Oracle(
        []() { return ARM_DWT_CYCCNT; }, cycleCounterOverhead);
    result.overrunCount = result.frameMax > kCycleBudget ? 1u : 0u;
    realtimeGraph.initialize(nmm::native::mcu::k101ReadyXFull,
                             nmm::native::mcu::k101ReadyYFull);
    // The helper includes the hash in its frame timing.  Keep a conservative
    // 20% margin for the interrupt's event-ring and transport bookkeeping.
    realtimeEnabled = result.failed == 0 && result.blocks == nmm::native::graph101_oracle::blocks
        && result.frameMax < (kCycleBudget * 4u) / 5u;
    if(realtimeEnabled)
        realtimeEnabled = sampleTimer.begin(
            sampleTick, 1000000.0f / static_cast<float>(kSampleRate));
    return result;
}

void report()
{
    Serial.print("{\"target\":\"");
    Serial.print(kTarget);
    Serial.print("\",\"stage\":\"native-101\",\"cpu_hz\":");
    Serial.print(F_CPU);
    Serial.print(",\"sample_rate\":");
    Serial.print(kSampleRate);
    Serial.print(",\"cycle_counter_overhead\":");
    Serial.print(cycleCounterOverhead);
    Serial.print(",\"cycle_budget\":");
    Serial.print(kCycleBudget);
    Serial.print(",\"rendered_frames\":");
    Serial.print(renderedFrames);
    Serial.print(",\"realtime_frames\":");
    Serial.print(realtimeFrames);
    Serial.print(",\"stepped_frames\":");
    Serial.print(steppedFrames);
    Serial.print(",\"realtime_control_max\":");
    Serial.print(realtimeControlMax);
    Serial.print(",\"realtime_sample_max\":");
    Serial.print(realtimeSampleMax);
    Serial.print(",\"realtime_frame_max\":");
    Serial.print(realtimeFrameMax);
    Serial.print(",\"realtime_overruns\":");
    Serial.print(realtimeOverruns);
    Serial.print(",\"realtime_enabled\":");
    Serial.print(realtimeEnabled ? "true" : "false");
    Serial.print(",\"midi_accepted\":");
    Serial.print(midiAccepted);
    Serial.print(",\"midi_applied\":");
    Serial.print(midiApplied);
    Serial.print(",\"midi_dropped\":");
    Serial.print(midiDropped);
    Serial.print(",\"voice_note\":");
    Serial.print(realtimeVoice.note);
    Serial.print(",\"voice_pitch\":");
    Serial.print(realtimeVoice.pitch);
    Serial.print(",\"voice_velocity_word\":");
    Serial.print(realtimeVoice.velocityWord);
    Serial.print(",\"voice_gate\":");
    Serial.print(realtimeVoice.gate);
    Serial.print(",\"voice_held\":");
    Serial.print(realtimeVoice.held ? "true" : "false");
    Serial.print(",\"realtime_audio_hash\":");
    Serial.print(static_cast<unsigned long long>(realtimeAudioHash));
    Serial.print(",\"offline_blocks\":");
    Serial.print(offlineResult.blocks);
    Serial.print(",\"offline_passed\":");
    Serial.print(offlineResult.passed);
    Serial.print(",\"offline_failed\":");
    Serial.print(offlineResult.failed);
    Serial.print(",\"offline_first_failure\":");
    if(offlineResult.firstFailure == 0xffffffffu) Serial.print(-1);
    else Serial.print(offlineResult.firstFailure);
    Serial.print(",\"offline_control_max\":");
    Serial.print(offlineResult.controlMax);
    Serial.print(",\"offline_control_min\":");
    Serial.print(offlineResult.controlMin);
    Serial.print(",\"offline_control_count\":");
    Serial.print(offlineResult.controlCount);
    Serial.print(",\"offline_control_total\":");
    Serial.print(static_cast<unsigned long long>(offlineResult.controlTotal));
    Serial.print(",\"offline_sample_max\":");
    Serial.print(offlineResult.sampleMax);
    Serial.print(",\"offline_sample_min\":");
    Serial.print(offlineResult.sampleMin);
    Serial.print(",\"offline_sample_count\":");
    Serial.print(offlineResult.sampleCount);
    Serial.print(",\"offline_sample_total\":");
    Serial.print(static_cast<unsigned long long>(offlineResult.sampleTotal));
    Serial.print(",\"offline_frame_max\":");
    Serial.print(offlineResult.frameMax);
    Serial.print(",\"offline_frame_min\":");
    Serial.print(offlineResult.frameMin);
    Serial.print(",\"offline_frame_count\":");
    Serial.print(offlineResult.frameCount);
    Serial.print(",\"offline_frame_total\":");
    Serial.print(static_cast<unsigned long long>(offlineResult.frameTotal));
    Serial.print(",\"offline_block_render_min\":");
    Serial.print(offlineResult.blockRenderMin);
    Serial.print(",\"offline_block_render_max\":");
    Serial.print(offlineResult.blockRenderMax);
    Serial.print(",\"offline_block_render_total\":");
    Serial.print(static_cast<unsigned long long>(offlineResult.blockRenderTotal));
    Serial.print(",\"offline_last_block_render_cycles\":");
    Serial.print(offlineResult.lastBlockRenderCycles);
    Serial.print(",\"offline_budget_overruns\":");
    Serial.print(offlineResult.overrunCount);
    Serial.print(",\"offline_last_audio_hash\":");
    Serial.print(static_cast<unsigned long long>(offlineResult.lastAudioHash));
    Serial.print(",\"offline_last_state_hash\":");
    Serial.print(static_cast<unsigned long long>(offlineResult.lastStateHash));
    Serial.print(",\"module_graph_verified\":");
    Serial.print(offlineResult.blocks != 0 && offlineResult.failed == 0 ? "true" : "false");
    Serial.println("}");
}
}

void setup()
{
    pinMode(LED_BUILTIN, OUTPUT);
    digitalWrite(LED_BUILTIN, HIGH);
    Serial.begin(115200);
    ARM_DEMCR |= ARM_DEMCR_TRCENA;
    ARM_DWT_CTRL |= ARM_DWT_CTRL_CYCCNTENA;
    const uint32_t begin = ARM_DWT_CYCCNT;
    const uint32_t end = ARM_DWT_CYCCNT;
    cycleCounterOverhead = end - begin;
    realtimeGraph.initialize(nmm::native::mcu::k101ReadyXFull,
                             nmm::native::mcu::k101ReadyYFull);
}

void loop()
{
    for(unsigned i = 0; i < 64 && usbMIDI.read(); ++i)
    {
        const uint8_t type = usbMIDI.getType();
        if(type == usbMIDI.NoteOn || type == usbMIDI.NoteOff)
            enqueueMidi(type, usbMIDI.getData1(), usbMIDI.getData2());
    }

    if(Serial.available())
    {
        const int command = Serial.read();
        if(command == '?' || command == 'r') report();
        if(command == 'g')
        {
            offlineResult = runOfflineGraphTest();
            report();
        }
        if(command == 's' && !realtimeEnabled)
        {
            for(unsigned i = 0; i < 64; ++i)
            {
                sampleTickCore(false);
            }
            report();
        }
    }

    const uint32_t now = millis();
    if(now - previousReport >= 1000)
    {
        previousReport = now;
        digitalToggleFast(LED_BUILTIN);
        if(Serial) report();
    }
}
